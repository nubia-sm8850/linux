## Documentation/devicetree/bindings/media/i2c/ovti,ov16e1q.yaml
```yaml
# SPDX-License-Identifier: (GPL-2.0-only OR BSD-2-Clause)
%YAML 1.2
---
$id: http://devicetree.org/schemas/media/i2c/ovti,ov16e1q.yaml#
$schema: http://devicetree.org/meta-schemas/core.yaml#

title: OmniVision OV16E1Q Image Sensor

description:
  The OmniVision OV16E1Q is a 16 megapixel quad-Bayer CMOS image sensor
  with a 4608x3456 active pixel array of 1.0 um pixels. It is controlled
  over an SCCB (I2C compatible) interface and transmits 10-bit RAW data
  over a four-lane MIPI CSI-2 D-PHY interface.

maintainers:
  - Luka Panio <lukapanio@gmail.com>

allOf:
  - $ref: /schemas/media/video-interface-devices.yaml#

properties:
  compatible:
    const: ovti,ov16e1q

  reg:
    maxItems: 1

  clocks:
    description: External clock (XCLK), 19.2 MHz.
    maxItems: 1

  reset-gpios:
    description: Active low GPIO connected to the XSHUTDOWN pad of the sensor.
    maxItems: 1

  avdd-supply:
    description: Analogue voltage supply.

  dovdd-supply:
    description: Digital I/O voltage supply, 1.8 volts.

  dvdd-supply:
    description:
      Digital core voltage supply. Optional, the core supply is normally
      generated by the on-chip regulator.

  port:
    $ref: /schemas/graph.yaml#/$defs/port-base
    additionalProperties: false

    properties:
      endpoint:
        $ref: /schemas/media/video-interfaces.yaml#
        unevaluatedProperties: false

        properties:
          data-lanes:
            items:
              - const: 1
              - const: 2
              - const: 3
              - const: 4

        required:
          - data-lanes
          - link-frequencies

required:
  - compatible
  - reg
  - clocks
  - port

unevaluatedProperties: false

examples:
  - |
    #include <dt-bindings/gpio/gpio.h>

    i2c {
        #address-cells = <1>;
        #size-cells = <0>;

        camera@36 {
            compatible = "ovti,ov16e1q";
            reg = <0x36>;

            clocks = <&camera_clk>;
            reset-gpios = <&tlmm 121 GPIO_ACTIVE_LOW>;

            avdd-supply = <&vreg_cam_avdd>;
            dovdd-supply = <&vreg_cam_dovdd>;

            orientation = <0>;
            rotation = <90>;

            port {
                endpoint {
                    data-lanes = <1 2 3 4>;
                    link-frequencies = /bits/ 64 <756000000>;
                    remote-endpoint = <&csiphy_in>;
                };
            };
        };
    };
...
```

## Documentation/devicetree/bindings/media/i2c/ovti,ov50h40.yaml
```yaml
# SPDX-License-Identifier: (GPL-2.0-only OR BSD-2-Clause)
%YAML 1.2
---
$id: http://devicetree.org/schemas/media/i2c/ovti,ov50h40.yaml#
$schema: http://devicetree.org/meta-schemas/core.yaml#

title: OmniVision OV50H40 Image Sensor

description:
  The OmniVision OV50H40 is a 50 megapixel CMOS image sensor with an
  8192x6144 active pixel array of 1.2 um pixels. It is controlled over an
  SCCB (I2C compatible) interface and transmits 10-bit RAW data over a
  three-trio MIPI CSI-2 C-PHY interface.

maintainers:
  - Luka Panio <lukapanio@gmail.com>

allOf:
  - $ref: /schemas/media/video-interface-devices.yaml#

properties:
  compatible:
    const: ovti,ov50h40

  reg:
    maxItems: 1

  clocks:
    description: External clock (XCLK), 24 MHz.
    maxItems: 1

  reset-gpios:
    description: Active low GPIO connected to the XSHUTDOWN pad of the sensor.
    maxItems: 1

  avdd-supply:
    description: Analogue voltage supply.

  dovdd-supply:
    description: Digital I/O voltage supply, 1.8 volts.

  dvdd-supply:
    description: Digital core voltage supply, 1.2 volts.

  port:
    $ref: /schemas/graph.yaml#/$defs/port-base
    additionalProperties: false

    properties:
      endpoint:
        $ref: /schemas/media/video-interfaces.yaml#
        unevaluatedProperties: false

        properties:
          bus-type:
            const: 1 # MEDIA_BUS_TYPE_CSI2_CPHY

          data-lanes:
            description: The three C-PHY trios.
            items:
              - const: 1
              - const: 2
              - const: 3

        required:
          - bus-type
          - data-lanes
          - link-frequencies

required:
  - compatible
  - reg
  - clocks
  - avdd-supply
  - dovdd-supply
  - dvdd-supply
  - port

unevaluatedProperties: false

examples:
  - |
    #include <dt-bindings/gpio/gpio.h>
    #include <dt-bindings/media/video-interfaces.h>

    i2c {
        #address-cells = <1>;
        #size-cells = <0>;

        camera@10 {
            compatible = "ovti,ov50h40";
            reg = <0x10>;

            clocks = <&camera_clk>;
            assigned-clocks = <&camera_clk>;
            assigned-clock-rates = <24000000>;

            reset-gpios = <&tlmm 118 GPIO_ACTIVE_LOW>;

            avdd-supply = <&vreg_cam_avdd>;
            dovdd-supply = <&vreg_cam_dovdd>;
            dvdd-supply = <&vreg_cam_dvdd>;

            orientation = <1>;
            rotation = <270>;

            port {
                endpoint {
                    bus-type = <MEDIA_BUS_TYPE_CSI2_CPHY>;
                    data-lanes = <1 2 3>;
                    link-frequencies = /bits/ 64 <1674020833>;
                    remote-endpoint = <&csiphy_in>;
                };
            };
        };
    };
...
```
